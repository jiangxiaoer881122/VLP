## prj.conf
```kconfig
CONFIG_USE_SEGGER_RTT=y
CONFIG_RTT_CONSOLE=y
CONFIG_LED=y
CONFIG_LOG=y
CONFIG_PWM=y
CONFIG_LOG_MODE_IMMEDIATE=y
CONFIG_I2C=y
CONFIG_I2C_NRFX=y
CONFIG_NRFX_TIMER0=y
CONFIG_ADC=y
CONFIG_UART_ASYNC_API=y
CONFIG_COUNTER=y
CONFIG_DMA=y
CONFIG_SYSCON=y
CONFIG_SERIAL=y
CONFIG_UART_INTERRUPT_DRIVEN=y

CONFIG_NRFX_SAADC=y
```

## src/main.c
```c
/*
 * Copyright (c) 2012-2014 Wind River Systems, Inc.
 *
 * SPDX-License-Identifier: Apache-2.0
 */
#include "imu_bag.h"
#include "timer.h"
#include "adc.h"
#include "iic_twi.h"
#include "icm_42688.h"
#include "uart.h"
#include <stdio.h>
#include "zephyr/logging/log.h"
#include "nrfx_saadc.h"
#include <zephyr/kernel.h>

//定义IIC的设备名称
struct device *i2c_dev;
#define I2C_DEV_NAME "I2C_0"
//用于进行flag的调用
int flag =0;
//存储一定的AD进而来进行在一定下进行输送
int pd[100];
int pd2[100];
//用于imu的数据发送
int count =0;
int imu_flag =0;
int b = 0;
int c = 1;
LOG_MODULE_REGISTER(adc, LOG_LEVEL_DBG);
#define CHANNEL_COUNT 2
static nrfx_saadc_channel_t single_channel = NRFX_SAADC_DEFAULT_CHANNEL_SE(NRF_SAADC_INPUT_AIN2, 0);
static nrfx_saadc_channel_t single_channel2 = NRFX_SAADC_DEFAULT_CHANNEL_SE(NRF_SAADC_INPUT_AIN1, 0);
nrf_saadc_value_t buffer[CHANNEL_COUNT];
/*时钟校准*/
void Bsp_HFCLK_Init_Extern()
{
    NRF_CLOCK->EVENTS_HFCLKSTARTED = 0;
    NRF_CLOCK->TASKS_HFCLKSTART = 1;

    while (NRF_CLOCK->EVENTS_HFCLKSTARTED == 0)
    {
        // Do nothing.
    }
}

int adc_init2(void)
{
	Bsp_HFCLK_Init_Extern();
	nrfx_err_t err;
	//初始化 输入初始化的中断优秀级
	//进行中断配置
	err = nrfx_saadc_init(NRFX_SAADC_DEFAULT_CONFIG_IRQ_PRIORITY);
	//配置通道的属性
	single_channel.channel_config.gain = NRF_SAADC_GAIN1_6;
	single_channel2.channel_config.gain = NRF_SAADC_GAIN1_6;
	//显示通道的采样时间间隔
	LOG_INF("TIME=%d\r\n",single_channel.channel_config.acq_time);
	LOG_INF("TIME=%d\r\n",single_channel2.channel_config.acq_time);
	//配置通道的index
	single_channel2.channel_index=1;
	//显示通道的位数
	LOG_INF("idex1=%d\r\n",single_channel.channel_index);
	LOG_INF("idex2=%d\r\n",single_channel2.channel_index);

	//nrfx_saadc_channel_config完成通道的配置
	err = nrfx_saadc_channel_config(&single_channel);
	LOG_INF("chan1 config %d\r\n",err);
	err = nrfx_saadc_channel_config(&single_channel2);
	LOG_INF("chan2 config %d\r\n",err);
	//nrfx_saadc_channels_configured_get();记录了当前配置的通道配置情况
	uint32_t channels_mask = nrfx_saadc_channels_configured_get();
	LOG_INF("ADC channels mask: %d\n", channels_mask);
	//设置通道分辨率为12bit，不使用过采样，事件回调
	err = nrfx_saadc_simple_mode_set(channels_mask, NRF_SAADC_RESOLUTION_12BIT, NRF_SAADC_OVERSAMPLE_DISABLED, NULL);
	printk("this %d\n",err);
	//在开始 SAADC 转换之前，您需要调用此函数来设置一个缓冲区，SAADC 将把采样数据存储到这个缓冲区中,这个是根据。
	err = nrfx_saadc_buffer_set(buffer, CHANNEL_COUNT);
	LOG_INF("supply : %d\n", err);
}

void adc_value_get(void)
{
	nrfx_err_t err;
	//nrfx_saadc_offset_calibrate(NULL);校准ADC的偏移量，这里不使用回调函数。
	err = nrfx_saadc_offset_calibrate(NULL);
	// LOG_INF("ADC : %d\n", err);
	//nrfx_saadc_mode_trigger();开始采集数据。
	err = nrfx_saadc_mode_trigger();
	// LOG_INF("ADC : %d\n", err);
	// return buffer[1];
}
//转换成电压
int adc_to_voltage(int adc_value)
{
	return (adc_value * 3600) / 4096;
}

int main(void)
{
	// //用于存储格式化字符串
	char str[200];
	char str2[200];
	// //字符指针
	char *P;
	int i=0,offset=0;
	//硬件IIC
	i2c_dev = device_get_binding(I2C_DEV_NAME);
	if(!i2c_dev)
	{
		printk("Failed\n");
		return 0;
	}else{
		printk("SUCCESS\n");
	}
	int err = i2c_configure(i2c_dev, I2C_SPEED_SET(I2C_SPEED_FAST));
    if (err) {
        printk("Failed to configure I2C device: %d\n", err);
        return 0;
    }
    printk("I2C device configured successfully\n");
	// 进行imu与bag的初始化
	imu_bag_init();
	// 进行adc初始化
	adc_init2();
	//进行串口初始化
	uart_init_slef();
	//进行定时器初始化 2k采样率 
 	timer1_init_enable();
	while (1)
	{
			if(imu_flag)
			{
			imu_flag =0;
			imu_bag_read_data();
			//pd1
			for(i=0;i<100;i++)
			{
				offset += sprintf(str + offset, "A:%d,", pd[i]); // 将整数转换为字符串并拼接到str中
			}
			P=str;
			print_uart(P);
			offset=0;
			//pd2
			for(i=0;i<100;i++)
			{
				offset += sprintf(str2 + offset, "B:%d,", pd2[i]); // 将整数转换为字符串并拼接到str中
			}
			P=str2;
			print_uart(P);
			offset=0;
			// }
		}else{
			//必须加否则会被优化
			c=1;
		}
	}
	return 0;
}
```

## src/adc.c
```c
/*
 * Copyright (c) 2020 Libre Solar Technologies GmbH
 *
 * SPDX-License-Identifier: Apache-2.0
 */
#include "adc.h"

/* Data of ADC io-channels specified in devicetree. */
static const struct adc_dt_spec adc_channels[] = {
    DT_FOREACH_PROP_ELEM(DT_PATH(zephyr_user), io_channels,
                         DT_SPEC_AND_COMMA)};
static int err;
// static uint32_t count = 0;
static uint16_t buf;
static struct adc_sequence sequence = {
    .buffer = &buf,
    /* buffer size in bytes, not number of samples */
    .buffer_size = sizeof(buf),
};
/**
 * @brief        adc初始化配置
 */
int adc_init(void)
{
    /* Configure channels individually prior to sampling. */
    for (size_t i = 0U; i < ARRAY_SIZE(adc_channels); i++)
    {
        if (!adc_is_ready_dt(&adc_channels[i]))
        {
            printk("ADC controller device %s not ready\n", adc_channels[i].dev->name);
            return 0;
        }

        err = adc_channel_setup_dt(&adc_channels[i]);
        if (err < 0)
        {
            printk("Could not setup channel #%d (%d)\n", i, err);
            return 0;
        }
        (void)adc_sequence_init_dt(&adc_channels[i], &sequence);
    }
    return 1;
}
/**
 * @brief        adc读取数据处理
 */
void adc_read_data(void)
{
	//用于存储格式化字符串
	char str[5];
	//字符指针
	char *ptr;

        // printk("ADC reading[%u]:\n", count++);
        for (size_t i = 0U; i < ARRAY_SIZE(adc_channels); i++)
        {
            int32_t val_mv;

            // printk("- %s, channel %d: ",
            //        adc_channels[i].dev->name,
            //        adc_channels[i].channel_id);
            // (void)adc_sequence_init_dt(&adc_channels[i], &sequence);
            err = adc_read(adc_channels[i].dev, &sequence);
            if (err < 0)
            {
                printk("Could not read (%d)\n", err);
                continue;
            }
            /*
             * If using differential mode, the 16 bit value
             * in the ADC sample buffer should be a signed 2's
             * complement value.
             */
            if (adc_channels[i].channel_cfg.differential)
            {
                val_mv = (int32_t)((int16_t)buf);
            }
            else
            {
                val_mv = (int32_t)buf;
            }
            // printk("ADC%\n" PRId32, val_mv);
            // printk("%d,", val_mv);

            //将整数格式化成指针
		    sprintf(str,"%d,",val_mv);
		    ptr =str;
    		print_uart(ptr);


            //下列代码是将ADC原始值变换为mV
            // err = adc_raw_to_millivolts_dt(&adc_channels[i],
            //                                &val_mv);
            // /* conversion to mV may not be supported, skip if not */
            // if (err < 0)
            // {
            //     printk(" (value in mV not available)\n");
            // }
            // else
            // {
            //     printk(" = %" PRId32 " mV\n", val_mv);
            // }
        }
}
```

## src/imu_bag.c
```c
/*
 * Copyright (c) 2012-2014 Wind River Systems, Inc.
 *
 * SPDX-License-Identifier: Apache-2.0
 */

#include "imu_bag.h"



uint8_t data[15];
uint8_t icm42688_data[15];
uint8_t lis3dml_data[15];
int16_t acc_data[3] = {0};
int16_t gyro_data[3] = {0};
int16_t mag_data[3] = {0};
uint32_t icm42688_timestamp = 0;
/**
 * @brief Read a sequence of bytes from a sensor registers 重新封装IIC的读取
 * 
 */
static void sensor_register_read(uint8_t sensor_addr, uint8_t reg_addr, uint8_t *data, uint8_t len)
{
	EspI2cReadBytes(sensor_addr, reg_addr, data, len);
}
/**
 * @brief Write a byte to a sensor register 重新封装IIC的写入
 */
static void sensor_register_write_byte(uint8_t sensor_addr, uint8_t reg_addr, uint8_t data)
{
	EspI2cWriteByte(sensor_addr, reg_addr, data);
}
/**
 * @brief icm (imu) 初始化写入命令
 */
void icm_init()
{
	sensor_register_write_byte(ICM_I2C_ADDR, ICM_BANK_SEL, 0);
	k_msleep(10);
	/* 读WHO_AM_I寄存器 */
	sensor_register_read(ICM_I2C_ADDR, ICM_WHO_AM_I, data, 1);
	printk("icm42688 read id:%X\n", data[0]);
	if (data[0] == ICM_ID)
	{
		printk("icm42688 ready!\n");
	}
	else
	{
		printk("icm42688 not found!\n");
	}
	/* 配置寄存器 */
	sensor_register_write_byte(ICM_I2C_ADDR, ICM_DEVICE_CONFIG, 0x01); // 软重启
	k_msleep(10);													   // 等待10ms

	sensor_register_write_byte(ICM_I2C_ADDR, ICM_POWER_MAG, 0x1F); // 开启陀螺仪和加速度计
	k_msleep(100);

	/* 配置FS和ODR */
	sensor_register_write_byte(ICM_I2C_ADDR, ICM_GYRO_CONFIG0, 0x67); // 250dps,200Hz
	k_msleep(50);
	sensor_register_write_byte(ICM_I2C_ADDR, ICM_ACCEL_CONFIG0, 0x47); // 4g, 100Hz
	k_msleep(50);
	sensor_register_write_byte(ICM_I2C_ADDR, ICM_GYRO_ACCEL_CONFIG0, 0x55); // 20Hz BW
	k_msleep(50);
	printk("icm42688 gyr and acc config finished!");

	/* 开启时间戳 */
	sensor_register_write_byte(ICM_I2C_ADDR, ICM_TMST_CONFIG, 0x33);
	k_msleep(50);
}
/**
 * @brief lis3dml (bag) 初始化写入命令
 */
void lis3dml_init()
{
	/* 读WHO_AM_I寄存器 */
	sensor_register_read(LIS3MDL_I2C_ADDR_G, LIS3MDL_WHO_AM_I, data, 1);
	printk("lis3dml read id:%X\n", data[0]);
	if (data[0] == LIS3MDL_ID)
	{
		printk("lis3dml ready!");
	}
	else
	{
		printk("lis3dml not found!");
	}
	/* 软重启 */
	sensor_register_write_byte(LIS3MDL_I2C_ADDR_G, LIS3MDL_CTRL_REG2, 0x04);
	/* 延时 */
	k_msleep(50);
	/* 配置BDU */
	sensor_register_write_byte(LIS3MDL_I2C_ADDR_G, LIS3MDL_CTRL_REG5, 0x40);
	/* 延时 */
	k_msleep(50);
	/* 配置 */
	sensor_register_write_byte(LIS3MDL_I2C_ADDR_G, LIS3MDL_CTRL_REG1, 0x60 | 0x1C); // X、Y轴high performance，80Hz
	sensor_register_write_byte(LIS3MDL_I2C_ADDR_G, LIS3MDL_CTRL_REG2, 0x00);		// ±4 gauss
	sensor_register_write_byte(LIS3MDL_I2C_ADDR_G, LIS3MDL_CTRL_REG3, 0x00);		// 连续转换模式
	sensor_register_write_byte(LIS3MDL_I2C_ADDR_G, LIS3MDL_CTRL_REG4, 0x0C);		// Z轴high performance
}
/**
 * @brief imu与bag 初始化程序
 */
 void imu_bag_init(void)
{
	I2cInit();
	/* 初始化icm42688 */
	icm_init();
	/* 初始化lis3dml */
	lis3dml_init();
}
/**
 * @brief imu与bag 读取程序
 */
void imu_bag_read_data( void)
{
	//用于存储格式化字符串
	char str_42688[120];
	char str_3dml[120];
	// 字符指针
	char *ptr_42688;
	char *ptr_3dml;

		/* ICM-42688-P 读数据 */
		sensor_register_write_byte(ICM_I2C_ADDR, ICM_BANK_SEL, 0);
		sensor_register_write_byte(ICM_I2C_ADDR, ICM_SIGNAL_PATH_RESET, 0x04);
		sensor_register_read(ICM_I2C_ADDR, ICM_ACCEL_DATA_X1, icm42688_data, 12);
		sensor_register_write_byte(ICM_I2C_ADDR, ICM_BANK_SEL, 1);
		// k_usleep(10);
		sensor_register_read(ICM_I2C_ADDR, ICM_TMSTVAL0, icm42688_data + 12, 3);

		/* LIS3DML读数据 */
		sensor_register_read(LIS3MDL_I2C_ADDR_G, LIS3MDL_OUT_X_L, lis3dml_data, 6);

		/* ICM42688打印数据 */
		acc_data[0] = (icm42688_data[0] << 8) + icm42688_data[1];
		acc_data[1] = (icm42688_data[2] << 8) + icm42688_data[3];
		acc_data[2] = (icm42688_data[4] << 8) + icm42688_data[5];

		gyro_data[0] = (icm42688_data[6] << 8) + icm42688_data[7];
		gyro_data[1] = (icm42688_data[8] << 8) + icm42688_data[9];
		gyro_data[2] = (icm42688_data[10] << 8) + icm42688_data[11];

		icm42688_timestamp = (icm42688_data[14] << 16) + (icm42688_data[13] << 8) + icm42688_data[12];

		// /* LIS3DML打印数据 */
		mag_data[0] = lis3dml_data[0] + (lis3dml_data[1] << 8);
		mag_data[1] = lis3dml_data[2] + (lis3dml_data[3] << 8);
		mag_data[2] = lis3dml_data[4] + (lis3dml_data[5] << 8);

		// 将上面两行数据直接用串口打印
		// 将整数格式化成指针
		sprintf(str_42688,"icm42688, acc_x:%d, acc_y:%d, acc_z:%d, gyr_x:%d, gyr_y:%d, gyr_z:%d, tick:%ld \n",acc_data[0], acc_data[1], acc_data[2],
			   gyro_data[0], gyro_data[1], gyro_data[2],(long int)icm42688_timestamp);
		ptr_42688 = str_42688;
		print_uart(ptr_42688);
		// memset(str_42688,0,sizeof(str_42688));

		sprintf(str_3dml,"lis3dml, mag_x:%d, mag_y:%d, mag_z:%d\n",
			   mag_data[0], mag_data[1], mag_data[2]);
		ptr_3dml = str_3dml;
		print_uart(ptr_3dml);
		// memset(str_3dml,0,sizeof(str_3dml));
}
```

## src/timer.c
```c
#include "timer.h"
#include "adc.h"
#include "nrfx_saadc.h"
/**
 * @brief 定时器事件处理函数
 *
 * @param[in] event_type 定时器的事件类型.
 * @param[in] p_context  传递的字节数
 */
extern int flag,count,imu_flag,pd[100],pd2[100];
extern nrf_saadc_value_t buffer[2];
void timer_handler(nrf_timer_event_t event_type, void * p_context)
{

    if(event_type == NRF_TIMER_EVENT_COMPARE0)
    {
        flag =(flag+1)%2;
        count++;
        adc_value_get();
        pd[count-1] = buffer[0];
        pd2[count-1] = buffer[1];        
        if(count%100==0)
        {
        count =count%100;
        imu_flag =1;
        }
    }
}

/**
 * @brief 定时器相关配置及启动
 *
 * @return Nothing.
 */
void timer1_init_enable(void)
{
    nrfx_err_t status;
    (void)status;
    nrfx_timer_t timer_inst = NRFX_TIMER_INSTANCE(TIMER_INST_IDX);
    //用于获取定时器的基频值
    uint32_t base_frequency = NRF_TIMER_BASE_FREQUENCY_GET(timer_inst.p_reg);
    //配置定时器的基本属性
    nrfx_timer_config_t config = NRFX_TIMER_DEFAULT_CONFIG(base_frequency);
    //打印定时器的频率值
    printk("this is time %d\n",base_frequency);
    config.bit_width = NRF_TIMER_BIT_WIDTH_32;
    config.p_context = "Some context";
    printf("config.frequnecy is %d",config.frequency);
    printf("config.mode is %d",config.mode);
    //初始化定时器
    status = nrfx_timer_init(&timer_inst, &config, timer_handler);
    NRFX_ASSERT(status == NRFX_SUCCESS);

#if defined(__ZEPHYR__)
    IRQ_DIRECT_CONNECT(NRFX_IRQ_NUMBER_GET(NRF_TIMER_INST_GET(TIMER_INST_IDX)), IRQ_PRIO_LOWEST,
                       NRFX_TIMER_INST_HANDLER_GET(TIMER_INST_IDX), 0);
#endif
    //清除定时器
    nrfx_timer_clear(&timer_inst);
    //直接通过转换来成计数器通道的配置数字，极大的简便了定时器的工作(这里可选择ms还是us)
    uint32_t desired_ticks = nrfx_timer_us_to_ticks(&timer_inst, TIME_TO_WAIT_US);
    // uint32_t desired_ticks = nrfx_timer_ms_to_ticks(&timer_inst, TIME_TO_WAIT_MS);
    printf("this is desired %d",desired_ticks);

    //用于使能定时器比较通道，使能比较中断，设置触发比较寄存器CC[n],根据通道来停止任务（或者清零）
    nrfx_timer_extended_compare(&timer_inst, NRF_TIMER_CC_CHANNEL0, desired_ticks,
                                NRF_TIMER_SHORT_COMPARE0_CLEAR_MASK, true);
    //使能定时器
    nrfx_timer_enable(&timer_inst);
    printk("timer is ok\n");
}
```

## src/timer.h
```c
/**
 * @file         timer.h
 * @details      用于timer 各类定义
 * @author       jjl
 */
#ifndef _TIMER_H
#define _TIMER_H

/*
===========================
头文件包括
===========================
*/
#include <nrfx_timer.h>
#include "imu_bag.h"
#include "adc.h"
#include <stdio.h>
#include <zephyr/kernel.h>
/*
===========================
宏定义
===========================
*/
/** @brief 选用哪个型号的定时器 */
#define TIMER_INST_IDX 0

/** @brief 等待时间以us为单位*/
#define TIME_TO_WAIT_US 500UL

/** @brief 等待时间以ms为单位*/
#define TIME_TO_WAIT_MS 50UL
/*
===========================
变量声明
===========================
*/
/*
===========================
函数声明
===========================
*/
/**
 * @brief 定时器事件处理函数
 *
 * @param[in] event_type 定时器的事件类型.
 * @param[in] p_context  传递的字节数
 */
void timer_handler(nrf_timer_event_t event_type, void * p_context);
/**
 * @brief 定时器相关配置及开启
 *
 * @return Nothing.
 */
void timer1_init_enable(void);

#endif
```

## src/uart.c
```c
/*
用于串口发送
 */

#include "uart.h"





/* queue to store up to 10 messages (aligned to 4-byte boundary) */
//初始化存储队列
K_MSGQ_DEFINE(uart_msgq, MSG_SIZE, 10, 4);

const struct device *const uart_dev = DEVICE_DT_GET(UART_DEVICE_NODE);

/* receive buffer used in UART ISR callback */
char rx_buf[MSG_SIZE];
int rx_buf_pos;

/*
 * Read characters from UART until line end is detected. Afterwards push the
 * data to the message queue.
 */
void serial_cb(const struct device *dev, void *user_data)
{
	uint8_t c;

	if (!uart_irq_update(uart_dev)) {
		return;
	}

	if (!uart_irq_rx_ready(uart_dev)) {
		return;
	}

	/* read until FIFO empty */
	while (uart_fifo_read(uart_dev, &c, 1) == 1) {
		if ((c == '\n' || c == '\r') && rx_buf_pos > 0) {
			/* terminate string */
			rx_buf[rx_buf_pos] = '\0';

			/* if queue is full, message is silently dropped */
			k_msgq_put(&uart_msgq, &rx_buf, K_NO_WAIT);

			/* reset the buffer (it was copied to the msgq) */
			rx_buf_pos = 0;
		} else if (rx_buf_pos < (sizeof(rx_buf) - 1)) {
			rx_buf[rx_buf_pos++] = c;
		}
		/* else: characters beyond buffer size are dropped */
	}
}

/*
 * Print a null-terminated string character by character to the UART interface
 */
void print_uart(char *buf)
{
	int msg_len = strlen(buf);

	for (int i = 0; i < msg_len; i++) {
		uart_poll_out(uart_dev, buf[i]);
	}
}
//串口初始化且注册中断处理函数
int uart_init_slef(void)
{
	if (!device_is_ready(uart_dev)) {
		printk("UART device not found!");
		return 0;
	}else{
		printk("hello uart\n");
	}
    	/* configure interrupt and callback to receive data */
	//进行中断处理函数的回调
	int ret = uart_irq_callback_user_data_set(uart_dev, serial_cb, NULL);

	if (ret < 0) {
		if (ret == -ENOTSUP) {
			printk("Interrupt-driven UART API support not enabled\n");
		} else if (ret == -ENOSYS) {
			printk("UART device does not support interrupt-driven API\n");
		} else {
			printk("Error setting UART callback: %d\n", ret);
		}
		return 0;
	}else{
		printk("hello ret\n");
	}
	uart_irq_rx_enable(uart_dev);
	printk("this is ok\n");
	printk("this is anther\n");	
    return 0;
}
```
